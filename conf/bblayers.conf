## conf/bblayers.conf
```bitbake
# ===========================================================================
# waifu-node — bblayers.conf
# Layer paths for standalone bitbake.
# ===========================================================================

LCONF_VERSION = "7"

BBPATH = "${TOPDIR}"
BBFILES ?= ""

BBLAYERS ?= " \
  ${TOPDIR}/external-layers/openembedded-core/meta \
  ${TOPDIR}/external-layers/meta-tegra \
  ${TOPDIR}/external-layers/meta-tegra-community \
  ${TOPDIR}/external-layers/meta-openembedded/meta-oe \
  ${TOPDIR}/external-layers/meta-openembedded/meta-filesystems \
  ${TOPDIR}/external-layers/meta-openembedded/meta-networking \
  ${TOPDIR}/external-layers/meta-openembedded/meta-python \
  ${TOPDIR}/external-layers/meta-virtualization \
  ${TOPDIR}/external-layers/meta-browser/meta-firefox \
  ${TOPDIR}/meta-waifu-node \
  "
```

## meta-waifu-node/conf/distro/waifu-node.conf
```bitbake
# ===========================================================================
# waifu-node — distro configuration
# ===========================================================================

# Distro name
DISTRO = "waifu-node"
DISTRO_NAME = "waifu-node"
DISTRO_VERSION = "1.0"
DISTRO_VENDOR = "waifu-node"
DISTRO_CODENAME = "wrynose"

FORTRAN:forcevariable = ",fortran"
HOSTTOOLS_NONFATAL += "gfortran"
#RUNTIMETARGET:append:class-native = " fortran"
#RUNTIMETARGET:append:pn-gcc-runtime = " libquadmath libgfortran"

# Default features (new syntax for bitbake 2.18)
DISTRO_FEATURES_DEFAULTS:append = " wayland x11 opengl pam systemd opencl"

PACKAGECONFIG:remove:pn-mesa = "gallium-llvm"

BLAS_AARCH64_ARCH := "ARMV9SME"
#PACKAGECONFIG:pn-python3-scipy := "lapack"
PACKAGECONFIG:pn-openblas := "openmp lapack lapacke"
#PACKAGECONFIG:pn-lapack := "cblas lapacke"
#PTEST_ENABLED:pn-lapack := "0"

PREFERRED_PROVIDER_python3-onnx := "onnx"
#PREFERRED_PROVIDER_python3-pytorch := "pytorch" 
#RPROVIDES:python3-torch = "python3-pytorch"

# License flags
LICENSE_FLAGS_ACCEPTED = "commercial"
```

## meta-waifu-node/conf/layer.conf
```bitbake
# ===========================================================================
# waifu-node — layer.conf (root layer)
# Declares the project root as a bitbake layer.
# ===========================================================================

BBPATH .= ":${LAYERDIR}"

BBFILES += "${LAYERDIR}/recipes-*/*/*.bb \
            ${LAYERDIR}/recipes-*/*/*.bbappend \
           "

BBFILE_COLLECTIONS += "waifu-node"
BBFILE_PATTERN_waifu-node = "^${LAYERDIR}/"
BBFILE_PRIORITY_waifu-node = "99"

WAIFU_NODE_LAYER_BASE = '${@os.path.normpath("${LAYERDIR}")}'

LAYERSERIES_COMPAT_waifu-node = "wrynose" 
```
